## subsys/mc/Kconfig
```kconfig
# Copyright (c) 2026 Mahdi Sahebi
# SPDX-License-Identifier: Apache-2.0

menuconfig MC
	bool "Micro Core communication services"
	default n
	help
	  Enable the experimental, heap-free Micro Core communication services.

if MC

config MC_COMM
	bool "Reliable byte communication"
	default y
	help
	  Enable framed, acknowledged byte communication using application-owned
	  storage and application-provided transport callbacks.

endif
```

## subsys/micro_core/Kconfig
```kconfig
# Copyright (c) 2026 Mahdi Sahebi
# SPDX-License-Identifier: Apache-2.0

menuconfig MC
	bool "Micro Core services"
	default n
	help
	  Enable the experimental, heap-free Micro Core services.

if MC

config MC_COMM
	bool "Reliable byte communication"
	select CRC
	default y
	help
	  Enable framed, acknowledged byte communication using application-owned
	  storage and application-provided transport callbacks.

config MC_MSG
	bool "ID-based message communication"
	depends on MC_COMM
	default y
	help
	  Enable message IDs, subscriptions, and zero-length signals on top of
	  MC_COMM.

config MC_POOL
	bool "Fixed-size memory pool"
	help
	  Enable a caller-owned pool with constant-time allocation, removal,
	  and clearing of fixed-size items.

endif
```
